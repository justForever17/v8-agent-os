## firmware/v8-device-executor-esp32/main/Kconfig.projbuild
```kconfig
menu "V8 low-voltage bench profile"
config V8_OUTPUT_GPIO
    int "LED logic output GPIO (never a mains load)"
    range 0 10
    default 4
config V8_SENSOR_GPIO
    int "Digital sensor input GPIO"
    range 0 10
    default 5
config V8_STOP_GPIO
    int "Active-low local Stop/arm button GPIO"
    range 0 10
    default 9
config V8_MAX_HOLD_MS
    int "Maximum output high duration in milliseconds"
    range 1 30000
    default 1000
endmenu
```

## firmware/v8-device-executor-esp32/sdkconfig.defaults
```kconfig
CONFIG_IDF_TARGET="esp32c3"
CONFIG_ESPTOOLPY_FLASHSIZE_4MB=y
CONFIG_PARTITION_TABLE_CUSTOM=y
CONFIG_PARTITION_TABLE_CUSTOM_FILENAME="partitions.csv"
CONFIG_NVS_ENCRYPTION=y
CONFIG_NVS_SEC_KEY_PROTECT_USING_HMAC=y
CONFIG_NVS_SEC_HMAC_EFUSE_KEY_ID=5
CONFIG_MBEDTLS_CERTIFICATE_BUNDLE=y
CONFIG_ESP_MAIN_TASK_STACK_SIZE=8192
CONFIG_LOG_DEFAULT_LEVEL_WARN=y
CONFIG_ESP_SYSTEM_PANIC_PRINT_REBOOT=y
CONFIG_ESP_TASK_WDT_EN=y
CONFIG_ESP_TASK_WDT_INIT=y
CONFIG_V8_OUTPUT_GPIO=4
CONFIG_V8_SENSOR_GPIO=5
CONFIG_V8_STOP_GPIO=9
CONFIG_V8_MAX_HOLD_MS=1000
```
